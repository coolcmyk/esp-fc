## port/video_probe/sdkconfig.defaults
```kconfig
CONFIG_CAMERA_OV5647=y
CONFIG_SPIRAM=y
CONFIG_SPIRAM_MODE_HEX=y
CONFIG_SPIRAM_SPEED_200M=y
CONFIG_SPIRAM_USE_MALLOC=y
CONFIG_FATFS_LFN_STACK=y
CONFIG_FATFS_MAX_LFN=64
```
